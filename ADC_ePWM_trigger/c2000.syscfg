/**
 * @cliArgs --device "F28004x" --part "F28004x_100PZ" --package "F28004x_100PZ" --context "system" --product "C2000WARE@5.01.00.00"
 * @versions {"tool":"1.21.0+3721"}
 */

/**
 * Import the modules used in this configuration.
 */
const adc     = scripting.addModule("/driverlib/adc.js", {}, false);
const adc1    = adc.addInstance();
const aio     = scripting.addModule("/driverlib/aio.js", {}, false);
const aio1    = aio.addInstance();
const asysctl = scripting.addModule("/driverlib/asysctl.js");
const epwm    = scripting.addModule("/driverlib/epwm.js", {}, false);
const epwm1   = epwm.addInstance();
const gpio    = scripting.addModule("/driverlib/gpio.js", {}, false);
const gpio1   = gpio.addInstance();

/**
 * Write custom configuration values to the imported modules.
 */
adc1.$name                       = "myADC0";
adc1.enabledSOCs                 = ["ADC_SOC_NUMBER0"];
adc1.enabledInts                 = ["ADC_INT_NUMBER1"];
adc1.interruptPulseMode          = "ADC_PULSE_END_OF_CONV";
adc1.soc0Trigger                 = "ADC_TRIGGER_EPWM1_SOCA";
adc1.registerInterrupts          = ["1"];
adc1.enableInterrupt1            = true;
adc1.adcBase                     = "ADCB_BASE";
adc1.soc0SampleWindow            = 8;
adc1.soc0UseSampleTimeCalculator = true;
adc1.adcClockPrescaler           = "ADC_CLK_DIV_2_0";
adc1.adcInt1.enableInterrupt     = true;

aio1.$name = "myAIO0";

asysctl.analogReferenceVoltage = "1P65";
asysctl.analogReference        = "INTERNAL";

epwm1.$name                                                    = "myEPWM0";
epwm1.epwmTimebase_hsClockDiv                                  = "EPWM_HSCLOCK_DIVIDER_1";
epwm1.epwmEventTrigger_EPWM_SOC_A_triggerEnable                = true;
epwm1.epwmEventTrigger_EPWM_SOC_A_triggerSource                = "EPWM_SOC_TBCTR_ZERO";
epwm1.epwmEventTrigger_EPWM_SOC_A_triggerEventPrescalar        = "1";
epwm1.epwmTimebase_counterMode                                 = "EPWM_COUNTER_MODE_UP_DOWN";
epwm1.epwmTimebase_period                                      = 250;
epwm1.epwmCounterCompare_cmpA                                  = 125;
epwm1.epwmCounterCompare_enableShadowLoadModeCMPA              = false;
epwm1.epwmCounterCompare_cmpB                                  = 10;
epwm1.epwmActionQualifier_EPWM_AQ_OUTPUT_A_ON_TIMEBASE_ZERO    = "EPWM_AQ_OUTPUT_HIGH";
epwm1.epwmActionQualifier_EPWM_AQ_OUTPUT_A_ON_TIMEBASE_UP_CMPB = "EPWM_AQ_OUTPUT_LOW";
epwm1.epwm.$assign                                             = "EPWM1";

gpio1.$name           = "myGPIO0";
gpio1.direction       = "GPIO_DIR_MODE_OUT";
gpio1.gpioPin.$assign = "GPIO10";

/**
 * Pinmux solution for unlocked pins/peripherals. This ensures that minor changes to the automatic solver in a future
 * version of the tool will not impact the pinmux you originally saw.  These lines can be completely deleted in order to
 * re-solve from scratch.
 */
aio1.aioPin.$suggestSolution          = "AIO228";
aio1.aioPin["AIO#"].$suggestSolution  = "A6/PGA5_OF";
epwm1.epwm.epwm_aPin.$suggestSolution = "GPIO0";
epwm1.epwm.epwm_bPin.$suggestSolution = "GPIO1";
