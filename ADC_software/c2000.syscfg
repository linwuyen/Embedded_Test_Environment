/**
 * @cliArgs --device "F28004x" --part "F28004x_100PZ" --package "F28004x_100PZ" --context "system" --product "C2000WARE@5.01.00.00"
 * @versions {"tool":"1.21.0+3721"}
 */

/**
 * Import the modules used in this configuration.
 */
const adc   = scripting.addModule("/driverlib/adc.js", {}, false);
const adc1  = adc.addInstance();
const epwm  = scripting.addModule("/driverlib/epwm.js", {}, false);
const epwm1 = epwm.addInstance();

/**
 * Write custom configuration values to the imported modules.
 */
adc1.$name              = "myADC0";
adc1.adcClockPrescaler  = "ADC_CLK_DIV_2_0";
adc1.enabledSOCs        = ["ADC_SOC_NUMBER0"];
adc1.soc0SampleWindow   = 200;
adc1.enabledInts        = ["ADC_INT_NUMBER1"];
adc1.enableInterrupt1   = true;
adc1.interruptPulseMode = "ADC_PULSE_END_OF_CONV";

epwm1.$name                                     = "myEPWM0";
epwm1.epwmTimebase_period                       = 500;
epwm1.epwmTimebase_hsClockDiv                   = "EPWM_HSCLOCK_DIVIDER_1";
epwm1.epwmTimebase_counterMode                  = "EPWM_COUNTER_MODE_DOWN";
epwm1.epwmEventTrigger_EPWM_SOC_A_triggerEnable = true;
epwm1.epwmEventTrigger_EPWM_SOC_A_triggerSource = "EPWM_SOC_TBCTR_ZERO";
epwm1.epwm.$assign                              = "EPWM1";

/**
 * Pinmux solution for unlocked pins/peripherals. This ensures that minor changes to the automatic solver in a future
 * version of the tool will not impact the pinmux you originally saw.  These lines can be completely deleted in order to
 * re-solve from scratch.
 */
epwm1.epwm.epwm_aPin.$suggestSolution = "GPIO0";
epwm1.epwm.epwm_bPin.$suggestSolution = "GPIO1";
